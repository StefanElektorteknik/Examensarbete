/*This code has been modified from the source code of the URL:https://github.com/paulvha/apollo3/tree/master/ble_amdtp_arduino/Amdtps
 This code is meant to use on the Server/Peripheral devises in the Bluetooth communication*/

#include "amdtp.h"
#include "apollo3.h"
#include <Wire.h>


//This is the 8192 Byte file that must be implementet to activate the sensor
//The configuration file was found from the URL address https://github.com/BoschSensortec/BMI270-Sensor-API/blob/master/bmi270.c
uint8_t init_file[] = {
    0xc8, 0x2e, 0x00, 0x2e, 0x80, 0x2e, 0x3d, 0xb1, 0xc8, 0x2e, 0x00, 0x2e, 0x80, 0x2e, 0x91, 0x03, 0x80, 0x2e, 0xbc,
    0xb0, 0x80, 0x2e, 0xa3, 0x03, 0xc8, 0x2e, 0x00, 0x2e, 0x80, 0x2e, 0x00, 0xb0, 0x50, 0x30, 0x21, 0x2e, 0x59, 0xf5,
    0x10, 0x30, 0x21, 0x2e, 0x6a, 0xf5, 0x80, 0x2e, 0x3b, 0x03, 0x00, 0x00, 0x00, 0x00, 0x08, 0x19, 0x01, 0x00, 0x22,
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    0x2e, 0x00, 0xc1};


//Declaration for alla valuse that is used in the code
uint8_t X0, X1;
int check = 0, message = 0, m = 0 , r = 0, g = 0, x=1;


//Deffine adresses
#define BMI270 0x68

// Function
void config_file();     // Function to configurate import the file and configurat the sensor
void test();            // Function to test if the ASIC is initialized
void rest_test_data();
void SendReplyClient();
void fulbuffer();
 
// Up to 29 characters
#define BLE_PERIPHERAL_NAME "STEFAN BLE I2C"

// Server version
#define MAJOR_SERVERVERSION 2         // new features implemented that require update to client
#define MINOR_SERVERVERSION 0         // bug fixes, better calculation / layout

// maximum length of reply / data message
#define MAXREPLY 4
  
/////////////////////////////////////////////////////////////////////
//
//  NO NEED FOR CHANGES AFTER THIS POINT
//
////////////////////////////////////////////////////////////////////

// buffer to reply to client
uint8_t  val[MAXREPLY];
uint8_t  *val_data = &val[2];   // start of optional data area
uint8_t  *val_len  = &val[1];   // store length of optional data

// for testdata
uint16_t TestCounter = 0;

/***********************************************************************/
void setup() {

#ifdef BLE_SHOW_DATA
  SERIAL_PORT.begin(115200);
  delay(1000);
  SERIAL_PORT.printf("Apollo3 BLE AMDTP protocol. Compiled: %s\n", __TIME__);
#endif

#ifdef AM_DEBUG_PRINTF
  //
  // Enable printing to the console.
  //
  enable_print_interface();
#endif
  pinMode(7, OUTPUT);
  digitalWrite(7,LOW);
  pinMode(8, OUTPUT);
  digitalWrite(8,LOW);
  pinMode(9, OUTPUT);
  digitalWrite(9,LOW);

  digitalWrite(7,HIGH);
  
  Wire.begin();         // Start the I2C communication

  config_file();
  
  Wire.beginTransmission(BMI270);
    Wire.write(0x43);             //Set the gyro range (GYR_RANGE)
    Wire.write(0x04);            //Set the gyr_range  at +/- 125 dps and ois_range to +/- 250 dps (degre per second)
  Wire.endTransmission();

  //
  // Configure the peripheral's advertised name:
  //
  setAdvName(BLE_PERIPHERAL_NAME);

  //
  // Boot the radio.
  //
  HciDrvRadioBoot(0);

  //
  // Initialize the main ExactLE stack.
  //
  exactle_stack_init();

  //
  // Start the "Amdtp" profile.
  //
  AmdtpStart();
  digitalWrite(7,LOW);
}

void loop() {
  //
  // if in chat mode
  //

  trigger_timers();

  am_hal_interrupt_master_disable();

  //
  // Check to see if the WSF routines are ready to go to sleep.
  //
  if ( wsfOsReadyToSleep() )
  {
      am_hal_sysctrl_sleep(AM_HAL_SYSCTRL_SLEEP_DEEP);
  }

  am_hal_interrupt_master_enable();
}

/*
 * This routine wl update the WSF timers on a regular base
 */

void trigger_timers()
{
  //
  // Calculate the elapsed time from our free-running timer, and update
  // the software timers in the WSF scheduler.
  //
  update_scheduler_timers();
  wsfOsDispatcher();            // start any handlers if event is pending on them

  //
  // Enable an interrupt to wake us up next time we have a scheduled event.
  //
  set_next_wakeup();
}

/*
 * This routine is called when data / cmd has been received from the client
 *
 * The case-values (like AMDTP_CMD_HELLO) needs to stay in sync with
 * the eAmdtpPktcmd_t definitions in BLE_amdtp.h
 */

void UserRequestReceived(uint8_t * buf, uint16_t len)
{
#ifdef BLE_SHOW_DATA
      SERIAL_PORT.printf("received command with length %d : ", len);
      for (uint16_t i = 0 ; i< len ; i++) SERIAL_PORT.printf("0x%X ", buf[i]);
      SERIAL_PORT.println();
#endif

    uint16_t value;
    int16_t ival;
    float fval;
    val[0] = buf[0];    // echo requested command
    *val_len = 0;       // set for zero optional data
    val_data = &val[2]; // set start of optional data

    trigger_timers();

    switch (buf[0]) {

      case AMDTP_CMD_START_TEST_DATA:
        #ifdef BLE_SHOW_DATA
            SERIAL_PORT.println("Send test data");
        #endif
        //fullbuffer();
        send_test_data();
        break;

      case AMDTP_CMD_STOP_TEST_DATA:
        #ifdef BLE_SHOW_DATA
            SERIAL_PORT.println("Stop test data");
        #endif

        rest_test_data();
        break;

     default:
        #ifdef BLE_SHOW_DATA
            SERIAL_PORT.printf("Unknown request : 0x%x", buf[0] );
        #endif
        val[0] = 0;             // indicate no defined action for this request
        break;
    }

    SendReplyClient();
  digitalWrite(9,LOW);
}

void send_test_data()
{
  digitalWrite(8, HIGH);
  Wire.beginTransmission(BMI270);
    Wire.write(0x14);             //Read the data from gyrosensors y-axel (LSB)
    Wire.write(0x15);             //Read the data from gyrosensors y-axel (MSB)
  Wire.endTransmission();

  Wire.requestFrom(0x68,2);

  if(Wire.available()){
    X0 = Wire.read();
    X1 = Wire.read();
    }
  digitalWrite(8,LOW);
  digitalWrite(9,HIGH);
 *val_data++ = X1;
 *val_data = X0;        // LSB

 *val_len = 2;
}

void fullbuffer(){
   *val_len = 100;
    for(int i=0; i<=50; i++){
      Wire.beginTransmission(BMI270);
        Wire.write(0x14);             //Read the data from gyrosensors y-axel (LSB)
        Wire.write(0x15);             //Read the data from gyrosensors y-axel (MSB)
      Wire.endTransmission();

      Wire.requestFrom(0x68,2);

      if(Wire.available()){
        X0 = Wire.read();
        X1 = Wire.read();
      }

      if(i == 50){
      *val_data++ = X1;
      *val_data = X0;
      }
      else{
      *val_data++ = X1;
      *val_data++ = X0;
      }
    }
    
  
  }

void rest_test_data()
{
  TestCounter = 0;
}

void SendReplyClient()
{
  if (AmdtpSendData(val, *val_len + 2) == false) {

    #ifdef BLE_Debug
      SERIAL_PORT.printf("Failed to sent data for client\n");
    #endif
  }
}

void config_file(){
  Wire.beginTransmission(BMI270);
    Wire.write(0x7E);             //Command Register (CMD)
    Wire.write(0xB6);             //Writing the softreset. It means that all the configurations will be declared as default.
  Wire.endTransmission();  
  
  delay(2);
  
  Wire.beginTransmission(BMI270);
    Wire.write(0x7C);             //Power mode configuration register (PWR_CONF)       
    Wire.write(0x02);             //Disable advanced power save and fast power up.
  Wire.endTransmission();         //Enabled FIFO read in low power mode
  
  delayMicroseconds(500);
  
  Wire.beginTransmission(BMI270);
    Wire.write(0x59);             //Start initialization address (INIT_CTRL)
    Wire.write(0x00);             //Starting the initialization
  Wire.endTransmission();

 //The Wire libary could maximum write 32 byte data at each transmission,
 //so instead did I write the 8192 byte kode part by part.  
 
 for(int j=0; j<273; j++){   
 
    Wire.beginTransmission(BMI270);
        Wire.write(0x5B);           //Address that is sorting the initialization data prat by part(INIT_ADDR_0)
        Wire.write(r);              //Vary the base address
        Wire.write(g);              //Reserve address
    Wire.endTransmission();
    
    Wire.beginTransmission(BMI270);
      Wire.write(0x5E);             //Initialzation register (INIT_DATA)
    
      for(int i=0;i<30;i++){
        Wire.write(init_file[m]);   // Register to initilize the data
        m++;
      }
    Wire.endTransmission();
    
    if(r==0){
        r=16;
        g--;
    }
    
    g++;
    r--;
   }

   //The for loop read up to 273*30 = 8190 bytes of data. 
   // It need to read 2 more byte to get the whole file.
   
   Wire.beginTransmission(BMI270);
      Wire.write(0x5B);
      Wire.write(15);
      Wire.write(255);
   Wire.endTransmission();
   
   Wire.beginTransmission(BMI270);
      Wire.write(0x5E);
      Wire.write(init_file[m]);
      Wire.write(init_file[m+1]);
   Wire.endTransmission();

  Wire.beginTransmission(BMI270);
    Wire.write(0x59);             //Start initialization address (INIT_CTRL)
    Wire.write(0x01);             //Stop the initialization 
  Wire.endTransmission();
  
  Wire.beginTransmission(BMI270);
    Wire.write(0x7C);             //Power mode configuration register (PWR_CONF) 
    Wire.write(0x03);             //Disable fast power up.
  Wire.endTransmission();         //Enabled FIFO read in low power mode and advanced power save
  
  Wire.beginTransmission(BMI270);
    Wire.write(0x7C);             //Power mode configuration register (PWR_CONF) 
    Wire.write(0x02);             //Disable fast power up and advanced power save.
  Wire.endTransmission();         //Enabled FIFO read in low power mode. 

  Wire.beginTransmission(BMI270);
    Wire.write(0x2F);             //Page number for feature configuration and outfput register (FEAT_PAGE)
    Wire.write(0x00);             //Use the default data 
  Wire.endTransmission();
  
  Wire.beginTransmission(BMI270);
    Wire.write(0x7C);             //Power mode configuration register (PWR_CONF)
    Wire.write(0x03);             //Disable fast power up.
  Wire.endTransmission();         //Enabled FIFO read in low power mode and advanced power save
  
  Wire.beginTransmission(BMI270);
    Wire.write(0x55);             //Configure interrupt modes (INT_LATCH)
    Wire.write(0x00);             // Using no latches
  Wire.endTransmission();

  Wire.beginTransmission(BMI270);
    Wire.write(0x58);             //Data interupt mapping(INT_MAP_DATA)
    Wire.write(0x04);             //Data ready to interupt for INT1
  Wire.endTransmission();

  Wire.beginTransmission(BMI270);
    Wire.write(0x7C);             //Power mode configuration register (PWR_CONF) 
    Wire.write(0x02);             //Disable fast power up and advanced power save.
  Wire.endTransmission();         //Enabled FIFO read in low power mode.
  
  Wire.beginTransmission(BMI270);
    Wire.write(0x40);             // Accelerometer configuration (ACC_CONF)
    Wire.write(0x88);//(0x98)     // Using odr_100, osr4_avg1 and preformance optimized.
    Wire.write(0x01);
  Wire.endTransmission(); 
  
  Wire.beginTransmission(BMI270);
    Wire.write(0x7C);
    Wire.write(0x02);
  Wire.endTransmission();

   delay(5);
   
  Wire.beginTransmission(BMI270);
    Wire.write(0x42);             //Gyroscope configurations (GYR_CONF)
    Wire.write(0x88);//(0x98)     //Using odr_100, osr4, power optimized in noise and preformance optimized in filter.    
    Wire.write(0x08);
  Wire.endTransmission();

  
  Wire.beginTransmission(BMI270);
    Wire.write(0x7C);
    Wire.write(0x03);
  Wire.endTransmission();
   
  Wire.beginTransmission(BMI270);
    Wire.write(0x7D);             //Power mode controll register(PWR_CTRL)
    Wire.write(0x02);             //Accelerometer and Gyroscope enabled
  Wire.endTransmission();
}
